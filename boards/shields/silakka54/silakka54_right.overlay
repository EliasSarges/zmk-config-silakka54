/*
 * Copyright (c) 2025 Seu Nome
 * SPDX-License-Identifier: MIT
 *
 * Adaptado do lily58_right.overlay, mantendo as referências &pro_micro.
 */

#include "silakka54.dtsi"

&kscan0 {
    // Col-gpios do Lily58 (lado direito), mantendo as referências &pro_micro
    col-gpios
        = <&pro_micro 21 GPIO_ACTIVE_HIGH>
        , <&pro_micro 20 GPIO_ACTIVE_HIGH>
        , <&pro_micro 19 GPIO_ACTIVE_HIGH>
        , <&pro_micro 18 GPIO_ACTIVE_HIGH>
        , <&pro_micro 15 GPIO_ACTIVE_HIGH>
        , <&pro_micro 14 GPIO_ACTIVE_HIGH>
        ;
};

&default_transform {
    col-offset = <6>;
};

// Removido: &right_encoder, pois não é garantido ou configurado aqui.

